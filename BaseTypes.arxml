AUTOSAR XML (schema 4-2-2)
standard types defined: uint32
package /BaseTypes
  base type uboolean: category=FIXED_LENTGH, base-type-size=8, base-type-encoding=BOOLEAN
